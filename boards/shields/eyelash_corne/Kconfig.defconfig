## boards/shields/eyelash_corne/Kconfig.defconfig
```kconfig
if SHIELD_EYELASH_CORNE_LEFT

config ZMK_KEYBOARD_NAME
    default "Eyelash Corne"

config ZMK_SPLIT_ROLE_CENTRAL
    default y

endif


if SHIELD_EYELASH_CORNE_LEFT || SHIELD_EYELASH_CORNE_RIGHT

config ZMK_SPLIT
    default y


if ZMK_BACKLIGHT

config PWM
    default y

config LED_PWM
    default y

endif # ZMK_BACKLIGHT

endif
```
